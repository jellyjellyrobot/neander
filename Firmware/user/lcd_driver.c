#include "ets_sys.h"
#include "osapi.h"
#include "c_types.h"
#include "gpio.h"
#include "os_type.h"
#include "user_config.h"
#include "user_interface.h"
#include "stdout/stdout.h"
#include "pcd8544/pcd8544.h"
#include "easygpio/easygpio.h"

//http://www.introtoarduino.com/utils/pcd8544.html

static uint8_t test_logo[] = {
  0x15, 0x00, 0x01, 0x6C, 0x11, 0x6C, 0x00, 0x7C, 0x44, 0x44, 0x00, 0x04,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 0x15,
  0x00, 0x00, 0x00, 0x01, 0x1F, 0x01, 0x00, 0x1F, 0x15, 0x15, 0x00, 0x17,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 0x00,
  0x00, 0x00, 0x00, 0x00, 0x00, 0x00, 0x00, 0x00, 0x00, 0x00, 0x00, 0x00,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 0x00,
  0x00, 0x00, 0x00, 0x00, 0x00, 0x00, 0x00, 0x00, 0x00, 0x00, 0x00, 0x00,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 0x00,
  0x00, 0x00, 0x00, 0x00, 0x00, 0x00, 0x00, 0x00, 0x00, 0x00, 0x00, 0x00,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 0x00,
  0xA8, 0x00, 0x80, 0x00, 0x80, 0x00, 0x00, 0x00, 0x00, 0x00, 0x00, 0x00,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 0xA8
};

#define user_procLcdUpdatePeriod 350
#define user_procTaskPrio 0
#define user_procTaskQueueLen 1

static volatile os_timer_t loop_timer;
os_event_t user_procTaskQueue[user_procTaskQueueLen];
static PCD8544_Settings pcd8544_settings;
static int contrast = 50;

void user_init(void);
static void loop(os_event_t *events);
static void nop_procTask(os_event_t *events);
static bool blah[10];


//Main code function
static void ICACHE_FLASH_ATTR
loop(os_event_t *events) {
  static uint32_t loopIterations = 0;
  loopIterations+=1;
  PCD8544_setContrast(contrast);
  if (loopIterations < 10) {
    PCD8544_lcdImage(test_logo);
  } else if (loopIterations == 10){
    PCD8544_lcdClear();
  } else {

    // Draw a Box
    PCD8544_drawLine();
    int a=0;
    PCD8544_gotoXY(10,1);
    // Put text in Box
    if (blah[0] && blah[1] && blah[2] && blah[3] && blah[4] && blah[5] && blah[6] && blah[7] && blah[8] && blah[9]){
      PCD8544_lcdPrint("TEST COMP");
    }else{
      PCD8544_lcdPrint("XCTF TEST");
    }
    
    PCD8544_gotoXY(24,2);

    if (gpio_input_get() & 1) {
      PCD8544_lcdCharacter('H');
      blah[5] = true;
    }else{
      PCD8544_lcdCharacter('h');
      blah[0] = true;
    }

    if (gpio_input_get() >> 2 & 1) {
      PCD8544_lcdCharacter('E');
      blah[5+1] = true;
    }else{
      PCD8544_lcdCharacter('e');
      blah[1] = true;
    }

    if (gpio_input_get() >> 4 & 1) {
      PCD8544_lcdCharacter('L');
      blah[5+2] = true;
    }else{
      PCD8544_lcdCharacter('l');
      blah[2] = true;
    }

    if (gpio_input_get() >> 5 & 1) {
      PCD8544_lcdCharacter('L');
      blah[5+3] = true;
    }else{
      PCD8544_lcdCharacter('l');
      if (contrast != 0){
        contrast--;
      }
      blah[3] = true;
    }

    if (!(gpio_input_get() >> 15 & 1)) {
      PCD8544_lcdCharacter('O');
      blah[5+4] = true;
    }else{
      PCD8544_lcdCharacter('o');
      if (contrast != 100){
        contrast++;
      }
      blah[4] = true;
    }

    if (loopIterations & 1){
      PCD8544_lcdCharacter(' ');
      PCD8544_lcdCharacter('=');
      // Draw + at this position
      PCD8544_gotoXY(10,2);
      PCD8544_lcdCharacter('=');
    } else {
      //PCD8544_gotoXY(24,2);
      PCD8544_lcdCharacter(' ');
      PCD8544_lcdCharacter('-');
      // Draw - at this position
      PCD8544_gotoXY(10,2);
      PCD8544_lcdCharacter('-');
    }
    //uint8_t contrast = ((loopIterations << 2)+25) & 0x3f; // +25 so that we start in the visible range
    PCD8544_setContrast(contrast);
    PCD8544_gotoXY(2,3);
    PCD8544_lcdPrint(" contrast:");
    char buf[] = "         ";
    os_sprintf(buf,"%d   ", contrast);
    PCD8544_gotoXY(32,4);
    PCD8544_lcdPrint(buf);
    os_printf("Updating display. Contrast = %d\n", contrast);
  }
}

/**
 * Setup program. When user_init runs the debug printouts will not always
 * show on the serial console. So i run the inits in here, 2 seconds later.
 */
static void ICACHE_FLASH_ATTR
setup(void) {
  pcd8544_settings.lcdVop = 0xB1; // -> influences the contrast by differing voltage levels
  pcd8544_settings.tempCoeff = 0x04; //04
  pcd8544_settings.biasMode = 0x13; //10 -> influences the flickering and contrast settings thru voltage trigger levels
  pcd8544_settings.inverse = false;

  pcd8544_settings.resetPin = -1; // 4;
  pcd8544_settings.scePin = -1; //5;

  pcd8544_settings.dcPin = 12;
  pcd8544_settings.sdinPin = 13;
  pcd8544_settings.sclkPin = 14;

  PCD8544_init(&pcd8544_settings);
  os_printf("pcd8544 lcd initiated\n");

  int select_ = 0;
  int up_ = 15;
  int down_ = 4;
  int left_ = 5;
  int right_ = 2;

  easygpio_pinMode(select_, EASYGPIO_NOPULL, EASYGPIO_INPUT);
  easygpio_pinMode(up_, EASYGPIO_NOPULL, EASYGPIO_INPUT);
  easygpio_pinMode(down_, EASYGPIO_PULLUP, EASYGPIO_INPUT);
  easygpio_pinMode(left_, EASYGPIO_PULLUP, EASYGPIO_INPUT);
  easygpio_pinMode(right_, EASYGPIO_NOPULL, EASYGPIO_INPUT);

  // Start loop timer
  os_timer_disarm(&loop_timer);
  os_timer_setfn(&loop_timer, (os_timer_func_t *) loop, NULL);
  os_timer_arm(&loop_timer, user_procLcdUpdatePeriod, true);
}

//Do nothing function
static void ICACHE_FLASH_ATTR
nop_procTask(os_event_t *events) {
  os_delay_us(10);
}

//Init function 
void ICACHE_FLASH_ATTR
user_init(void)
{
  // Make uart0 work with just the TX pin. Baud:115200,n,8,1
  // The RX pin is now free for GPIO use.
  stdout_init();

  // turn off WiFi for this console only demo
  wifi_station_set_auto_connect(false);
  wifi_station_disconnect();

  os_timer_disarm(&loop_timer);

  // Start setup timer
  os_timer_setfn(&loop_timer, (os_timer_func_t *) setup, NULL);
  os_timer_arm(&loop_timer, user_procLcdUpdatePeriod*2, false);

  //Start no-operation os task
  system_os_task(nop_procTask, user_procTaskPrio, user_procTaskQueue, user_procTaskQueueLen);
  system_os_post(user_procTaskPrio, 0, 0);
}
